## Kconfig
```kconfig
menu "RapidReach Modules"
rsource "src/Kconfig.rapidreach"
endmenu

menu "RapidReach Examples Configuration"
rsource "src/examples/Kconfig.examples"
endmenu

source "Kconfig.zephyr"
```

## boards/alnicko/speaker/Kconfig.defconfig
```kconfig
if BOARD_SPEAKER

if WATCHDOG

config IWDG_STM32_INITIAL_TIMEOUT
	default 15000

endif # BOARD_SPEAKER

endif # BOARD_SPEAKER
```

## boards/alnicko/speaker/board.yml
```yaml
board:
  name: speaker
  full_name: RPR001-SCH-001-Rxx Speaker Board
  vendor: alnicko
  revision:
    format: number
    exact: false
    default: "1"
    revisions:
      - name: "1"
  socs:
    - name: stm32h573xx
    
```

## boards/cavli_c16qs_service.conf
```kconfig
# cavli_c16qs_service.conf
#
# This configuration file is used together with cavli_c16qs_service.overlay
# to create a service firmware image for initial modem configuration.
#
# The service firmware allows:
# - Setting the modem's UART speed
# - Switching to hardware flow control mode
#
# Do not modify anything in this file.
# Detailed instructions are provided in cavli_c16qs_service.overlay

# RapidReach project config
CONFIG_RPR_NETWORKING=y
CONFIG_RPR_MODEM=y
CONFIG_RPR_ETHERNET=n
CONFIG_RPR_HASH_CALCULATION=y
CONFIG_RPR_WIFI=n

# Needs for debugging
CONFIG_RPR_MODULE_CLI_SHELL_TEST=y
# Networking test
CONFIG_SHELL_WILDCARD=n
# For file system shell
CONFIG_HEAP_MEM_POOL_SIZE=8192

# Needed when the device is first started. 
# Set the external SIM instead of eSIM
# Next, it may not be used.
CONFIG_MODEM_CAVLI_C16QS_ENABLE_SIMSWAP=y
```

## boards/nrf7002_ek.conf
```kconfig
# This conf file is intended for use with the nrf7002_ek module 
# on the STM32H573I-DK development board.

# RapidReach project config
CONFIG_RPR_NETWORKING=y
CONFIG_RPR_MODEM=n
CONFIG_RPR_ETHERNET=y
CONFIG_RPR_WIFI=y
CONFIG_RPR_HASH_CALCULATION=y

# Wi-Fi buffers 
CONFIG_HEAP_MEM_POOL_SIZE=153600
```

## boards/speaker.conf
```kconfig
# RapidReach project config
CONFIG_RPR_NETWORKING=y
CONFIG_RPR_MODULE_CHARGER=y
CONFIG_RPR_MODULE_BATTERY=y
CONFIG_RPR_MODULE_AUDIO_PLAYER=y
CONFIG_RPR_I2S_AUDIO_CODEC=y
CONFIG_RPR_MEASURING_DECODE_TIME=y
# File system for audio storage
CONFIG_RPR_MODULE_FILE_MANAGER=y
CONFIG_RPR_MODULE_MICROPHONE=y
CONFIG_RPR_MODEM=y
CONFIG_RPR_ETHERNET=y
CONFIG_RPR_HASH_CALCULATION=y
CONFIG_RPR_WIFI=n
CONFIG_RPR_MODULE_MQTT=y

# MQTT Configuration
CONFIG_RPR_MQTT_BROKER_HOST="192.168.2.79"

# Needs for debugging
CONFIG_RPR_MODULE_CLI_SHELL_TEST=y
# Networking test
CONFIG_SHELL_WILDCARD=n
# For file system shell
# CONFIG_HEAP_MEM_POOL_SIZE=8192

# General config
CONFIG_SHELL_STACK_SIZE=8192 
CONFIG_MAIN_STACK_SIZE=4096

# Network init config
CONFIG_NET_CONFIG_INIT_TIMEOUT=1

# Network address config
CONFIG_NET_IF_MAX_IPV4_COUNT=3
CONFIG_NET_IPV6=n
CONFIG_NET_MAX_CONN=16

# DHCP configuration for automatic IP assignment
CONFIG_NET_DHCPV4=y
CONFIG_NET_CONFIG_AUTO_INIT=y

# Network buffers 
CONFIG_NET_PKT_RX_COUNT=16
CONFIG_NET_PKT_TX_COUNT=16
CONFIG_NET_BUF_RX_COUNT=128
CONFIG_NET_BUF_TX_COUNT=128
CONFIG_NET_TX_STACK_SIZE=1200
CONFIG_NET_RX_STACK_SIZE=1200

CONFIG_MODEM_CELLULAR_CMUX_MAX_FRAME_SIZE=2048
CONFIG_NET_TCP_MAX_RECV_WINDOW_SIZE=1024 

# Needed when the device is first started. 
# Set the external SIM instead of eSIM
# Next, it may not be used.
CONFIG_MODEM_CAVLI_C16QS_ENABLE_SIMSWAP=y

# Adjustment for DFU slot
CONFIG_SPI_NOR_FLASH_LAYOUT_PAGE_SIZE=8192

# Wi-Fi buffers 
CONFIG_HEAP_MEM_POOL_SIZE=153600
CONFIG_LOG_BUFFER_SIZE=4096

# Wi-Fi config for net_mgmt
CONFIG_NET_MGMT_EVENT_QUEUE_TIMEOUT=5000
CONFIG_NET_MGMT_EVENT_QUEUE_SIZE=16
CONFIG_NET_MGMT_EVENT_STACK_SIZE=8192

# For IC in which the MAC address is not specified
# CONFIG_WIFI_RANDOM_MAC_ADDRESS is not set

# TLS configuration
CONFIG_MBEDTLS_HEAP_SIZE=65000
CONFIG_MBEDTLS_SSL_MAX_CONTENT_LEN=16384
CONFIG_MBEDTLS_BUILTIN=y
CONFIG_RPR_ENABLE_HTTPS=y

# RapidReach Examples Configuration
CONFIG_EXAMPLES_ENABLE_MAIN_EXAMPLES=y
CONFIG_EXAMPLES_ENABLE_ALNICKO_SHELL=y
CONFIG_EXAMPLES_DOMAIN_LOGIC_LOG_LEVEL=4
CONFIG_EXAMPLES_POWER_SUPERVISOR_LOG_LEVEL=4
CONFIG_EXAMPLES_DOMAIN_LOGIC_AUTO_CONNECT_ON_START=y
CONFIG_RPR_DISABLE_WATCHDOG_WHILE_DEBUG=y
```

## boards/stm32f4_disco.conf
```kconfig
# RapidReach project config
CONFIG_RPR_MODULE_CHARGER=y
CONFIG_RPR_MODULE_BATTERY=y
CONFIG_RPR_ADC_OVERSAMPLING=0
CONFIG_RPR_ADC_CALIBRATE=n
CONFIG_RPR_MODULE_AUDIO_PLAYER=y
CONFIG_RPR_MEASURING_DECODE_TIME=y
CONFIG_RPR_MODULE_MICROPHONE=y

# CONFIG_THREAD_ANALYZER=y 
# CONFIG_THREAD_ANALYZER_USE_PRINTK=y 
# CONFIG_THREAD_ANALYZER_AUTO=y 
# CONFIG_THREAD_ANALYZER_AUTO_INTERVAL=5
```

## boards/stm32h573i_dk.conf
```kconfig
# RapidReach project config
CONFIG_RPR_NETWORKING=y
CONFIG_RPR_MODULE_CHARGER=y
CONFIG_RPR_MODULE_BATTERY=y
CONFIG_RPR_MODULE_AUDIO_PLAYER=y
CONFIG_RPR_I2S_AUDIO_CODEC=n
CONFIG_RPR_MEASURING_DECODE_TIME=y
CONFIG_RPR_MODULE_MICROPHONE=y
CONFIG_RPR_MODEM=n
CONFIG_RPR_ETHERNET=y
CONFIG_RPR_WIFI=y
CONFIG_RPR_MODULE_MQTT=y

# MQTT Configuration
CONFIG_RPR_MQTT_BROKER_HOST="192.168.2.79"
CONFIG_RPR_HASH_CALCULATION=y

# Needs for debugging
CONFIG_RPR_MODULE_CLI_SHELL_TEST=y
# Networking test
CONFIG_SHELL_WILDCARD=n
# For file system shell
CONFIG_HEAP_MEM_POOL_SIZE=8192

# General config
CONFIG_SHELL_STACK_SIZE=8192
CONFIG_MAIN_STACK_SIZE=4096

# Network init config
CONFIG_NET_CONFIG_INIT_TIMEOUT=1

# Network address config
CONFIG_NET_IF_MAX_IPV4_COUNT=3
CONFIG_NET_IPV6=n

# DHCP configuration for automatic IP assignment
CONFIG_NET_DHCPV4=y
CONFIG_NET_CONFIG_AUTO_INIT=y

# Network buffers
CONFIG_NET_PKT_RX_COUNT=16
CONFIG_NET_PKT_TX_COUNT=16
CONFIG_NET_BUF_RX_COUNT=128
CONFIG_NET_BUF_TX_COUNT=128
CONFIG_NET_TX_STACK_SIZE=1200
CONFIG_NET_RX_STACK_SIZE=1200

CONFIG_MODEM_CELLULAR_CMUX_MAX_FRAME_SIZE=2048
CONFIG_NET_TCP_MAX_RECV_WINDOW_SIZE=1024 

# Wi-Fi config for net_mgmt
CONFIG_NET_MGMT_EVENT_QUEUE_TIMEOUT=5000
CONFIG_NET_MGMT_EVENT_QUEUE_SIZE=16
CONFIG_NET_MGMT_EVENT_STACK_SIZE=8192
```

## drivers/Kconfig
```kconfig
if MODEM
rsource "c16qs/Kconfig.cavli-c16qs"
endif # MODEM 

if AUDIO
rsource "cs43l22/Kconfig.cs43l22"
endif # AUDIO 
```

## drivers/c16qs/Kconfig.cavli-c16qs
```kconfig
config MODEM_CAVLI_C16QS
	bool "Generic cellular modem support"
	select MODEM_MODULES
	select MODEM_PPP
	select MODEM_CMUX
	select MODEM_CHAT
	select MODEM_PIPE
	select MODEM_PIPELINK
	select MODEM_BACKEND_UART
	select RING_BUFFER
	select NET_L2_PPP_OPTION_MRU
	select NET_L2_PPP_PAP
	depends on DT_HAS_CAVLI_C16QS_ENABLED
	help
	  This enables support for the Cavli C16QS modem using PPP over UART.

if MODEM_CAVLI_C16QS

config MODEM_CELLULAR_APN
	string "APN"
	default "internet"

config MODEM_CELLULAR_PERIODIC_SCRIPT_MS
	int "Periodic script interval in milliseconds"
	default 2000

config MODEM_CELLULAR_UART_BUFFER_SIZES
	int "The UART receive and transmit buffer sizes in bytes."
	default 512

config MODEM_CELLULAR_CMUX_MAX_FRAME_SIZE
	int "The maximum CMUX frame size in bytes."
	default 32 if DT_HAS_U_BLOX_LARA_R6_ENABLED
	default 128
	help
	  This value affects the size of buffers used to receive and transmit CMUX frames.

config MODEM_CELLULAR_CHAT_BUFFER_SIZES
	int "The size of the buffers used for the chat scripts in bytes."
	default 128

config MODEM_CELLULAR_USER_PIPE_BUFFER_SIZES
	int "The size of the buffers used for each user pipe in bytes."
	default 128

config MODEM_CELLULAR_NEW_BAUDRATE
	int "New baudrate to configure modem to, if supported"
	range 9600 4000000
	default 3000000 if DT_HAS_U_BLOX_LARA_R6_ENABLED
	default 115200

config MODEM_CELLULAR_NEW_BAUDRATE_DELAY
	int "Time modem takes to change baudrate, in milliseconds"
	range 0 1000
	default 100 if DT_HAS_U_BLOX_LARA_R6_ENABLED
	default 300

config MODEM_CAVLI_C16QS_ENABLE_SIMSWAP
	bool "Enable AT^SIMSWAP=1 command during modem init"
	default n
	help
	  If enabled, the AT^SIMSWAP=1 command will be sent during initialization.
	  This command is used to select external SIM Card instead of internal eSIM.
	  Should be used the first time the device is started up.

endif
```

## dts/bindings/modem/cavli,c16qs.yaml
```yaml
description: Cavli C16QS modem

compatible: "cavli,c16qs"

include: uart-device.yaml

properties:
  mdm-power-gpios:
    type: phandle-array
    required: true

  mdm-reset-gpios:
    type: phandle-array
```

## src/Kconfig.rapidreach
```kconfig
rsource "led_control/Kconfig.led"
rsource "switch_module/Kconfig.switch"
rsource "poweroff/Kconfig.poweroff"
rsource "charger/Kconfig.charger"
rsource "dev_info/Kconfig.dev_info"
rsource "watchdog/Kconfig.watchdog"
rsource "system_watchdog/Kconfig.sys_watchdog"
rsource "battery/Kconfig.battery"
rsource "audio_player/Kconfig.audio"
rsource "microphone/Kconfig.microphone"

config RPR_NETWORKING
    bool "Enable RapidReach Networking Stack"
    select NETWORKING
    select NET_NATIVE
    select NET_IPV4
    select NET_SOCKETS
    select NET_CONTEXT_RCVTIMEO
    select DNS_RESOLVER
    select NET_CONTEXT_NET_PKT_POOL
    select NET_MGMT
    select NET_MGMT_EVENT
    select NET_CONNECTION_MANAGER
    select TEST_RANDOM_GENERATOR
    select NET_CONFIG_NEED_IPV4
    select NET_CONFIG_SETTINGS
    default n
    help
      Enable base networking stack and IPv4 support for RapidReach.

if RPR_NETWORKING

config RPR_NET_SHELL_SUPPORT
    bool "Enable NET Shell to test"
    select NET_SHELL
    depends on RPR_NETWORKING
    default y if RPR_MODULE_CLI_SHELL_TEST 
    help
      Enable networking shell commands.

rsource "ethernet/Kconfig.ethernet"
rsource "modem/Kconfig.modem"
rsource "wifi/Kconfig.wifi"
rsource "mqtt_module/Kconfig.mqtt"
rsource "http_module/Kconfig.http"


endif # RPR_NETWORKING

rsource "cli/Kconfig.cli"
rsource "file_manager/Kconfig.file"

rsource "dfu_manager/Kconfig.dfu"
rsource "rtc/Kconfig.rtc"
```

## src/audio_player/Kconfig.audio
```kconfig
menuconfig RPR_MODULE_AUDIO_PLAYER
    bool "Enable Audio Player module"
    select EVENTS
	  default n
    help
      Enable audio playback using I2S and audio codec.

if RPR_MODULE_AUDIO_PLAYER
config RPR_MODULE_AUDIO_PLAYER_LOG_LEVEL
    int "Audio Player module log level"
    range 0 4
    default 3
    help
      0=OFF, 1=ERROR, 2=WARNING, 3=INFO, 4=DEBUG

config RPR_I2S_AUDIO_CODEC
    bool "Enable Audio Codec and I2S"
    default y if RPR_MODULE_AUDIO_PLAYER
    select I2S
    select AUDIO
    select AUDIO_CODEC
    help
      Enable audio, I2S and audio codec.
      Automatically selects CONFIG_I2S, CONFIG_AUDIO, CONFIG_AUDIO_CODEC.

config RPR_I2S_BLOCK_BUFFERS
  	int "Count of audio data blocks"
  	default 4
  	help
  	  Controls the count of audio data blocks  

config RPR_SAMPLE_FREQ
	  int "Sample rate"
	  default 48000
	  help
	    Default sample rate (NOTE: Decoder uses actual rate from Opus file header)


config RPR_MEASURING_DECODE_TIME
    bool "Enable measurement of audio decode time"
  	default n
    help
      If enabled, the system will measure and display the time   taken
      to decode each audio file or audio data block.
      Useful for analyzing codec performance and system loading.

config RPR_DEFAULT_VOLUME_LEVEL
    int "Default audio volume level"
    default -70
    help
      Set the default volume level for audio playback after system startup. 

config RPR_DEFAULT_MUTE_STATE
    bool "Default mute state"
    default n
    help
      Set the default mute state for the audio player.
      If enabled, audio playback will start muted until unmuted manually.

config RPR_AUDIO_AUTO_MUTE
    bool "Enable automatic mute on start/stop"
    default y
    help
      If enabled, the audio player will automatically unmute the output
      at the beginning of playback and mute after playback ends.
      If disabled, mute can be managed manually.

config RPR_AUDIO_PLAYER_STEREO
    bool "Enable stereo output"
    default n
    help
      If enabled, the audio will be used stereo playback (2 channels).
      If disabled, mono playback will be used (1 channel).

config RPR_AUDIO_COUNT_SILENCE_BLOCK
    int "Number of silence blocks after audio"
    default 64
    help
      The number of blocks of silence to play at the beginning and end of audio playback.

config RPR_AUDIO_ENABLE_STANDBY_WHEN_IDLE
    bool "Enable standby mode when audio is idle"
    default y
    help
      When enabled, the system will enter standby or low-power mode 
      while no audio is playing. The mode will automatically disable 
      when audio playback starts and re-enable when playback ends.

endif
```

## src/battery/Kconfig.battery
```kconfig
menuconfig RPR_MODULE_BATTERY
    bool "Enable Battery measurement module"
    select ADC
	  default n
    help
      Enable reading battery voltage and level.
      Automatically selects CONFIG_ADC.

if RPR_MODULE_BATTERY
config RPR_MODULE_BATTERY_LOG_LEVEL
    int "Battery module log level"
    range 0 4
    default 3
    help
      0=OFF, 1=ERROR, 2=WARNING, 3=INFO, 4=DEBUG
      
config RPR_ADC_RESOLUTION
    int "ADC resolution for battery measurement"
    range 8 16
    default 12
    help
      Set the ADC (Analog-to-Digital Converter) resolution used
      for battery voltage measurements.
      Typical values: 8, 10, 12, 14, 16 bits.

config RPR_ADC_OVERSAMPLING
    int "ADC oversampling for battery measurement"
    range 0 256
    default 4
    help
      Number of samples to average for each ADC measurement.
      0 disables oversampling. 
      Typical values: 4, 8, 16, 32, 64, 128, 256.

config RPR_ADC_CALIBRATE
    bool "Perform ADC calibration before battery measurement"
    default y
    help
      Enable to perform ADC calibration before taking battery voltage measurements.
      Improves measurement accuracy on some hardware.
endif
```

## src/charger/Kconfig.charger
```kconfig
menuconfig RPR_MODULE_CHARGER
    bool "Enable Charger control module"
    select GPIO
	  default n
    help
      Enable battery charger control.
      Automatically selects CONFIG_GPIO.

if RPR_MODULE_CHARGER
config RPR_MODULE_CHARGER_LOG_LEVEL
    int "Charger module log level"
    range 0 4
    default 3
    help
      0=OFF, 1=ERROR, 2=WARNING, 3=INFO, 4=DEBUG
endif
```

## src/cli/Kconfig.cli
```kconfig
config RPR_MODULE_CLI_SHELL
    bool "Enable CLI (Shell) support"
    depends on RPR_MODULE_LED && RPR_MODULE_SWITCH && RPR_MODULE_POWEROFF && \
    RPR_MODULE_CHARGER && RPR_MODULE_DEV_INFO && RPR_MODULE_WATCHDOG && \
    RPR_MODULE_BATTERY && RPR_MODULE_AUDIO_PLAYER && RPR_MODULE_MICROPHONE
    select SERIAL
    select SHELL
    default y
     help
      Enable the command-line interface (CLI) via serial port.

config RPR_MODULE_CLI_SHELL_TEST
    bool "Enable CLI Shell Test Commands"
    depends on RPR_MODULE_CLI_SHELL
    default n
    help
      Enable additional SHELL commands and features for testing and development.
```

## src/dev_info/Kconfig.dev_info
```kconfig
menuconfig RPR_MODULE_DEV_INFO
    bool "Enable Device Info module"
    select GPIO
    select HWINFO
  	default y
    help
      Enable device revision and firmware version reading.
      Automatically selects CONFIG_GPIO and CONFIG_HWINFO.

if RPR_MODULE_DEV_INFO
config RPR_MODULE_DEV_INFO_LOG_LEVEL
    int "Device Info module log level"
    range 0 4
    default 3
    help
      0=OFF, 1=ERROR, 2=WARNING, 3=INFO, 4=DEBUG

config RPR_DEVICE_ID_BIN_MAX_SIZE
    int "Maximum binary size of device ID"
    default 12
    help
      Defines how many bytes to copy from the hardware device ID.
    
endif
```
