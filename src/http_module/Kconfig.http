## src/http_module/Kconfig.http
```kconfig
menuconfig RPR_MODULE_HTTP
    bool "Enable HTTP module"
    select POSIX_API
    select HTTP_CLIENT
    select NET_TCP
    select NET_CONTEXT_RCVTIMEO
    select NET_CONTEXT_SNDTIMEO
    default y
    help
      Enable HTTP module with support for client operations.
      Automatically selects required network and POSIX APIs.

if RPR_MODULE_HTTP
config RPR_MODULE_HTTP_LOG_LEVEL
    int "HTTP module log level"
    range 0 4
    default 3
    help
      0=OFF, 1=ERROR, 2=WARNING, 3=INFO, 4=DEBUG

config RPR_ENABLE_HTTPS
    bool "Enable HTTPS support"
    select MBEDTLS
    select MBEDTLS_ENABLE_HEAP
    select MBEDTLS_PEM_CERTIFICATE_FORMAT
    select NET_SOCKETS_SOCKOPT_TLS
    default n
    help
      Enable HTTPS support in the HTTP module.
      Selects mbedTLS with heap-based memory and PEM certificate format.

config RPR_HTTP_MAX_URL_LENGTH
	int "Maximum length of the HTTP URL"
	default 256

config RPR_HTTP_RECV_BUFFER_SIZE
    int "HTTP receive buffer size (in bytes)"
    default 256
    help
      Size of the buffer used to receive HTTP response data chunks.

config RPR_HASH_CALCULATION
    bool "Enable calculation SHA-256 hash after download"
    select REQUIRES_FULL_LIBC
    select MBEDTLS
    select MBEDTLS_ENABLE_HEAP
    select MBEDTLS_MD
    default n
    help
      Print the SHA-256 hash of the downloaded content. Useful for verifying integrity.

endif
```

## src/init_state_machine/Kconfig.init_sm
```kconfig
menuconfig RPR_MODULE_INIT_SM
    bool "Enable initialization state machine"
    default y
    help
      Enable state machine for managing device initialization sequence
      including network connectivity, device registration, and MQTT setup.

if RPR_MODULE_INIT_SM

config RPR_MODULE_INIT_SM_LOG_LEVEL
    int "Initialization state machine log level"
    range 0 4
    default 3
    help
      0=OFF, 1=ERROR, 2=WARNING, 3=INFO, 4=DEBUG

config RPR_INIT_SM_NETWORK_TIMEOUT_SEC
    int "Network wait timeout in seconds"
    default 30
    help
      Maximum time to wait for network connectivity during initialization.

config RPR_INIT_SM_REGISTRATION_TIMEOUT_SEC
    int "Device registration timeout in seconds"
    default 10
    help
      Maximum time to wait for device registration to complete.

config RPR_INIT_SM_MQTT_TIMEOUT_SEC
    int "MQTT connection timeout in seconds"
    default 10
    help
      Maximum time to wait for MQTT connection to be established.

config RPR_INIT_SM_MAX_RETRIES
    int "Maximum retry count for failed operations"
    default 3
    help
      Maximum number of retries for failed operations before giving up.

config RPR_INIT_SM_RETRY_DELAY_SEC
    int "Retry delay in seconds"
    default 5
    help
      Delay between retry attempts after failures.

endif # RPR_MODULE_INIT_SM
```

## src/led_control/Kconfig.led
```kconfig
menuconfig RPR_MODULE_LED
    bool "Enable LED control module"
    select GPIO
	  default y
    help
      Enable support for controlling LEDs.
      Automatically selects CONFIG_GPIO.

if RPR_MODULE_LED
config RPR_MODULE_LED_LOG_LEVEL
    int "LED module log level"
    range 0 4
    default 3
    help
      0=OFF, 1=ERROR, 2=WARNING, 3=INFO, 4=DEBUG
endif
```

## src/log_settings/Kconfig
```kconfig
menuconfig LOG_SETTINGS
    bool "Enable persistent log level settings"
    depends on LOG_RUNTIME_FILTERING
    depends on RPR_MODULE_FILE_MANAGER
    default y
    help
      Enable saving and restoring log filter settings to/from
      persistent storage. Settings are stored as JSON in the
      filesystem.

if LOG_SETTINGS

config LOG_SETTINGS_SHELL
    bool "Enable shell commands for log settings"
    depends on SHELL
    default y
    help
      Enable shell commands to save, load, and clear log settings.
      Commands: log_settings save, log_settings load, log_settings clear

config LOG_SETTINGS_AUTO_SAVE
    bool "Automatically save log settings on change"
    default n
    help
      Automatically save log settings when they are changed via
      shell commands. This requires hooking into the log control
      system which may add overhead.

config LOG_SETTINGS_AUTO_LOAD
    bool "Automatically load settings on boot"
    default y
    help
      Automatically load and apply saved log settings during
      system initialization.

endif # LOG_SETTINGS
```

## src/microphone/Kconfig.microphone
```kconfig
menuconfig RPR_MODULE_MICROPHONE
    bool "Enable Microphone module"
	  default n
    help
      Enable microphone to sound detection.

if RPR_MODULE_MICROPHONE
config RPR_MODULE_MICRO_LOG_LEVEL
    int "Microphone module log level"
    range 0 4
    default 3
    help
      0=OFF, 1=ERROR, 2=WARNING, 3=INFO, 4=DEBUG
endif
```

## src/modem/Kconfig.modem
```kconfig
menuconfig RPR_MODEM
    bool "Enable Modem support" 
    depends on RPR_NETWORKING && NET_NATIVE
    select UART_INTERRUPT_DRIVEN
    select SERIAL
    # select POSIX_API
    select NET_L2_PPP_OPTION_DNS_USE
    select MODEM
    select PM_DEVICE
    select MODEM_CAVLI_C16QS
    select NET_L2_PPP
    # select NET_PPP
    default n
    help
      Enable support for the cellular modem C16QS.

if RPR_MODEM

config RPR_MODEM_LOG_LEVEL
    int "Modem module log level"
    range 0 4
    default 3
    help
      0=OFF, 1=ERROR, 2=WARNING, 3=INFO, 4=DEBUG

config RPR_MODEM_TEST_SUPPORT
    default y if RPR_MODULE_CLI_SHELL_TEST 
    bool "Enable modem shell testing support"
    select MODEM_AT_SHELL
    select PM_DEVICE_SHELL
    select MODEM_STATS
    select SHELL
    help
      Enable debugging/testing shell commands for modem.

config RPR_MODEM_AUTO_CONNECT
    bool "Automatically connect modem at boot"
    default n
    help
      If enabled, the modem will be powered on and connected automatically
      during system initialization instead of requiring manual CLI commands.

endif # RPR_MODEM
```

## src/mqtt_log_client/Kconfig.mqtt_log
```kconfig
menuconfig RPR_MQTT_LOG_CLIENT
    bool "Enable MQTT Log Client"
    depends on RPR_NETWORKING
    default n
    help
      Enable on-device MQTT log client with batching and filesystem FIFO buffering.

if RPR_MQTT_LOG_CLIENT

config RPR_MQTT_LOG_TOPIC_PREFIX
    string "MQTT logs topic prefix"
    default "logs"

config RPR_MQTT_LOG_BATCH_MAX
    int "Max log items per batch"
    default 200
    range 1 1000

config RPR_MQTT_LOG_BATCH_BYTES
    int "Max JSON batch size (bytes)"
    default 4096
    range 512 16384

config RPR_MQTT_LOG_FLUSH_INTERVAL_MS
    int "Flush interval (ms)"
    default 500
    range 50 5000

config RPR_MQTT_LOG_RAM_ENTRIES
    int "RAM buffer entries"
    default 64
    range 4 512

config RPR_MQTT_LOG_FS_DIR
    string "FS directory"
    default "/logs"

config RPR_MQTT_LOG_FS_FILE_BYTES
    int "FS chunk file size (bytes)"
    default 4096
    range 512 16384

config RPR_MQTT_LOG_FS_MAX_FILES
    int "FS max files"
    default 64
    range 4 1024

config RPR_MQTT_LOG_FS_MAX_BYTES
    int "FS max total bytes"
    default 262144
    range 4096 8388608

endif # RPR_MQTT_LOG_CLIENT

menuconfig LOG_BACKEND_MQTT
    bool "Enable MQTT log backend"
    depends on RPR_MQTT_LOG_CLIENT && LOG
    default y if RPR_MQTT_LOG_CLIENT
    help
      Enable Zephyr log backend that forwards all logs to MQTT.

if LOG_BACKEND_MQTT

config LOG_BACKEND_MQTT_OUTPUT_DEFAULT
    int "Default log format"
    default 0
    help
      Default log format for MQTT backend.

endif # LOG_BACKEND_MQTT
```

## src/mqtt_module/Kconfig.mqtt
```kconfig
menuconfig RPR_MODULE_MQTT
    bool "Enable MQTT module"
    select POSIX_API
    select MQTT_LIB
    select NET_TCP
    select NET_CONTEXT_RCVTIMEO
    select NET_CONTEXT_SNDTIMEO
    default n
    help
      Enable MQTT module with support for publishing and subscribing.
      Includes periodic heartbeat/alive message functionality.

if RPR_MODULE_MQTT

config RPR_MODULE_MQTT_LOG_LEVEL
    int "MQTT module log level"
    range 0 4
    default 3
    help
      0=OFF, 1=ERROR, 2=WARNING, 3=INFO, 4=DEBUG

config RPR_MQTT_BROKER_HOST
    string "MQTT broker hostname or IP"
    default "localhost"
    help
      The hostname or IP address of the MQTT broker to connect to.

config RPR_MQTT_BROKER_PORT
    int "MQTT broker port"
    range 1 65535
    default 1883
    help
      The port number of the MQTT broker (typically 1883 for non-TLS).

config RPR_MQTT_CLIENT_ID
    string "MQTT client ID"
    default "rapidreach_device"
    help
      The client ID to use when connecting to the MQTT broker.

config RPR_MQTT_HEARTBEAT_TOPIC
    string "MQTT heartbeat topic"
    default "rapidreach/heartbeat"
    help
      The MQTT topic to publish heartbeat/alive messages to.

config RPR_MQTT_HEARTBEAT_INTERVAL_SEC
    int "Heartbeat interval in seconds"
    range 1 3600
    default 30
    help
      How often to publish heartbeat messages (in seconds).

config RPR_MQTT_KEEPALIVE_SEC
    int "MQTT keep-alive interval in seconds"
    range 10 300
    default 60
    help
      MQTT keep-alive interval for the connection.

config RPR_MQTT_USERNAME
    string "MQTT username"
    help
      Username for authenticating to the MQTT broker. Leave unset for anonymous.

config RPR_MQTT_PASSWORD
    string "MQTT password"
    help
      Password for authenticating to the MQTT broker. Leave unset for anonymous.

config RPR_MQTT_FALLBACK_BROKER_ENABLED
    bool "Enable fallback MQTT broker"
    default n
    help
      Enable fallback to a secondary MQTT broker if primary broker fails.

config RPR_MQTT_FALLBACK_BROKER_HOST
    string "Fallback MQTT broker hostname or IP"
    default "37.123.169.250"
    depends on RPR_MQTT_FALLBACK_BROKER_ENABLED
    help
      The hostname or IP address of the fallback MQTT broker (e.g., public cloud broker).

config RPR_MQTT_FALLBACK_BROKER_PORT
    int "Fallback MQTT broker port"
    range 1 65535
    default 1883
    depends on RPR_MQTT_FALLBACK_BROKER_ENABLED
    help
      The port number of the fallback MQTT broker.

config RPR_MQTT_PRIMARY_RETRIES
    int "Number of retries before using fallback broker"
    range 1 20
    default 5
    depends on RPR_MQTT_FALLBACK_BROKER_ENABLED
    help
      Number of connection attempts to primary broker before falling back to secondary.

rsource "Kconfig.mqtt_wrapper"

endif # RPR_MODULE_MQTT
```

## src/mqtt_module/Kconfig.mqtt_wrapper
```kconfig
# MQTT Client Wrapper Configuration

menuconfig RPR_MQTT_CLIENT_WRAPPER
    bool "Enable thread-safe MQTT client wrapper"
    depends on RPR_MODULE_MQTT
    default y
    help
      Enable the thread-safe MQTT client wrapper with improved reliability.
      This wrapper provides non-blocking operations, automatic reconnection,
      and proper thread separation between protocol and application logic.

if RPR_MQTT_CLIENT_WRAPPER

config MQTT_WRAPPER_PROTOCOL_STACK_SIZE
    int "Protocol thread stack size"
    default 12288
    help
      Stack size for the MQTT protocol thread that handles mqtt_input(),
      mqtt_live(), and reconnection logic. Increased to handle event processing safely.

config MQTT_WRAPPER_WORKER_STACK_SIZE
    int "Worker thread stack size"
    default 16384
    help
      Stack size for the worker thread that processes received messages.
      Should be large enough to handle file I/O, JSON parsing, and message callbacks.

config MQTT_WRAPPER_RX_BUFFER_SIZE
    int "MQTT receive buffer size"
    default 8192
    help
      Size of the buffer for receiving MQTT messages. Limited to 8KB
      since larger audio files should use streaming instead of in-memory.

config MQTT_WRAPPER_TX_BUFFER_SIZE
    int "MQTT transmit buffer size"
    default 2048
    help
      Size of the buffer for transmitting MQTT messages.

config MQTT_WRAPPER_MSG_QUEUE_SIZE
    int "Message queue size"
    default 10
    help
      Number of messages that can be queued for processing.

config MQTT_WRAPPER_PUB_QUEUE_SIZE
    int "Publish queue size"
    default 20
    help
      Number of publish operations that can be queued.

config MQTT_WRAPPER_MAX_SUBSCRIPTIONS
    int "Maximum number of subscriptions"
    default 8
    help
      Maximum number of topic subscriptions supported.

config MQTT_WRAPPER_RECONNECT_MIN_INTERVAL_MS
    int "Minimum reconnection interval (ms)"
    default 5000
    help
      Minimum time to wait between reconnection attempts.

config MQTT_WRAPPER_RECONNECT_MAX_INTERVAL_MS
    int "Maximum reconnection interval (ms)"
    default 300000
    help
      Maximum time to wait between reconnection attempts (5 minutes default).

config MQTT_WRAPPER_PROTOCOL_THREAD_PRIORITY
    int "Protocol thread priority"
    default 7
    help
      Priority of the MQTT protocol thread. Lower values = higher priority.
      Should be high priority to ensure timely keepalive transmission.

config MQTT_WRAPPER_WORKER_THREAD_PRIORITY
    int "Worker thread priority"
    default 5
    help
      Priority of the message processing worker thread.

endif # RPR_MQTT_CLIENT_WRAPPER
```

## src/poweroff/Kconfig.poweroff
```kconfig
menuconfig RPR_MODULE_POWEROFF
    bool "Enable Poweroff module"
    select GPIO
	  default y
    help
      Enable power button handling and shutdown.
      Automatically selects CONFIG_GPIO.

if RPR_MODULE_POWEROFF
config RPR_MODULE_POWEROFF_LOG_LEVEL
    int "Poweroff module log level"
    range 0 4
    default 3
    help
      0=OFF, 1=ERROR, 2=WARNING, 3=INFO, 4=DEBUG
endif
```

## src/rtc/Kconfig.rtc
```kconfig
menuconfig RPR_MODULE_RTC
    bool "Enable RTC module"
    select RTC
	  default y
    help
      Enable real-time clock (RTC) module.
      Automatically selects CONFIG_RTC.

if RPR_MODULE_RTC
config RPR_MODULE_RTC_LOG_LEVEL
    int "RTC module log level"
    range 0 4
    default 3
    help
      0=OFF, 1=ERROR, 2=WARNING, 3=INFO, 4=DEBUG
endif
```

## src/sntp_sync/Kconfig
```kconfig
menuconfig RPR_MODULE_SNTP_SYNC
	bool "SNTP Time Synchronization Module"
	depends on SNTP && NET_SOCKETS
	default y
	help
	  Enable SNTP (Simple Network Time Protocol) time synchronization.
	  This module automatically synchronizes system time with NTP servers
	  and updates the RTC.

if RPR_MODULE_SNTP_SYNC

config RPR_MODULE_SNTP_SYNC_LOG_LEVEL
	int "Log level for SNTP sync module"
	default 3
	range 0 4
	help
	  Log level for SNTP synchronization module:
	  0 = Off, 1 = Error, 2 = Warning, 3 = Info, 4 = Debug

config RPR_MODULE_SNTP_SYNC_AUTO_START
	bool "Automatically start periodic SNTP sync on network connect"
	default y
	help
	  When enabled, SNTP synchronization will automatically start
	  when network connectivity is established.

config RPR_MODULE_SNTP_SYNC_INTERVAL
	int "Periodic sync interval in seconds"
	default 3600
	range 60 86400
	depends on RPR_MODULE_SNTP_SYNC_AUTO_START
	help
	  Time interval between automatic SNTP synchronization attempts.
	  Default is 3600 seconds (1 hour). Minimum is 60 seconds (1 minute).

endif # RPR_MODULE_SNTP_SYNC
```

## src/switch_module/Kconfig.switch
```kconfig
menuconfig RPR_MODULE_SWITCH
    bool "Enable Switch module"
    select GPIO
	  default y
    help
      Enable support for switch reading.
      Automatically selects CONFIG_GPIO.

if RPR_MODULE_SWITCH
config RPR_MODULE_SWITCH_LOG_LEVEL
    int "Switch module log level"
    range 0 4
    default 3
    help
      0=OFF, 1=ERROR, 2=WARNING, 3=INFO, 4=DEBUG
endif
```
