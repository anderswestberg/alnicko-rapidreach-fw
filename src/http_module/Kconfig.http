## src/system_watchdog/Kconfig.sys_watchdog
```kconfig
menuconfig RPR_MODULE_SYSTEM_WATCHDOG
    bool "Enable System Watchdog control module"
    select WATCHDOG
	  default y if BOOTLOADER_MCUBOOT
    help
      Enable internal watchdog functionality.
      Handles freezes both during reboot and during update.
      Automatically selects CONFIG_WATCHDOG.

if RPR_MODULE_SYSTEM_WATCHDOG
config RPR_MODULE_SYSTEM_WATCHDOG_LOG_LEVEL
    int "System watchdog module log level"
    range 0 4
    default 3
    help
      0=OFF, 1=ERROR, 2=WARNING, 3=INFO, 4=DEBUG


config RPR_MODULE_SYSTEM_WATCHDOG_TIMEOUT_MS
    int "Watchdog timeout (ms)"
    range 1 26214
    default 15000
    help
      Maximum allowed time (in milliseconds) before the watchdog triggers a reset.
      Must match hardware limitations (for STM32 IWDG max is 26214 ms).
      This value is used to configure the watchdog expiration window.

endif
```

## src/watchdog/Kconfig.watchdog
```kconfig
menuconfig RPR_MODULE_WATCHDOG
    bool "Enable Watchdog control module"
    select GPIO
	  default y
    help
      Enable watchdog functionality.
      Automatically selects CONFIG_GPIO.

if RPR_MODULE_WATCHDOG
config RPR_MODULE_WATCHDOG_LOG_LEVEL
    int "Watchdog module log level"
    range 0 4
    default 3
    help
      0=OFF, 1=ERROR, 2=WARNING, 3=INFO, 4=DEBUG

config RPR_DISABLE_WATCHDOG_WHILE_DEBUG
    bool "Disable watchdog reset for debugging"
    default n
    help
      If enabled, the watchdog will be disabled or its reset will be suspended
      while the CPU is halted in debug mode. This allows you to debug
      the application without the board being reset by the watchdog timer.
endif
```

## src/wifi/Kconfig.wifi
```kconfig
menuconfig RPR_WIFI
    bool "Enable Wi-Fi support"
    depends on RPR_NETWORKING
    select WIFI
    select CONFIG_HEAP_MEM_POOL_IGNORE_MIN
    default n 
    help
      Enable Wi-Fi networking stack.

if RPR_WIFI

config RPR_WIFI_LOG_LEVEL
    int "Wi-Fi module log level"
    range 0 4
    default 3
    help
      0=OFF, 1=ERROR, 2=WARNING, 3=INFO, 4=DEBUG

config RPR_WIFI_GET_SCAN_RESULT
    bool "Enable retrieval of Wi-Fi scan results"
    default n
    help
      Enable API to retrieve and access the last scanned Wi-Fi networks.

config RPR_WIFI_SCAN_RESULT_MAX_SIZE
    int "Maximum number of stored Wi-Fi scan results"
    depends on RPR_WIFI_GET_SCAN_RESULT
    range 1 64
    default 10
    help
      Defines how many scan results will be stored and returned
      when retrieving scan data.

config RPR_WIFI_SHELL_SUPPORT
    bool "Enable WI-FI Shell to test"
    select NET_L2_WIFI_SHELL
    depends on RPR_WIFI
    default y if RPR_MODULE_CLI_SHELL_TEST 
    help
      Enable Wi-Fi L2 shell commands.

endif # RPR_WIFI
```

## west-manifest/west.yml
```yaml
manifest:
  remotes:
    - name: zephyrproject
      url-base: https://github.com/zephyrproject-rtos
    - name: xiph
      url-base: https://github.com/xiph
    - name: ncs
      url-base: https://github.com/nrfconnect

  projects:
    - name: zephyr
      repo-path: zephyr
      remote: zephyrproject
      revision: v4.0.0
      clone-depth: 1
      import:
        path-prefix: external
        name-allowlist:
          - cmsis
          - cmsis-dsp
          - picolibc
          - segger
          - hal_stm32
          - mbedtls
          - littlefs
          - mcuboot
          - hal_nordic
          - hostap

    - name: opus
      repo-path: opus
      remote: xiph
      revision: v1.3.1
      path: external/modules/lib/opus

    - name: ogg
      repo-path: ogg
      remote: xiph
      revision: v1.3.5
      path: external/modules/lib/ogg

    - name: opus-tools
      repo-path: opus-tools
      remote: xiph
      revision: v0.2
      path: external/modules/lib/opus-tools
```
