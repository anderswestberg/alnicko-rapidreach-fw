## src/device_registry/Kconfig.device_registry
```kconfig
menuconfig RPR_MODULE_DEVICE_REGISTRY
    bool "Enable GitHub-based device registry"
    default n
    depends on RPR_MODULE_HTTP
    help
      Enable device registry module that uses GitHub as backend
      for collision-free device ID assignment.
      This requires the HTTP module to be enabled.

if RPR_MODULE_DEVICE_REGISTRY

config RPR_MODULE_DEVICE_REGISTRY_LOG_LEVEL
    int "Device registry module log level"
    range 0 4
    default 3
    help
      0=OFF, 1=ERROR, 2=WARNING, 3=INFO, 4=DEBUG

config RPR_DEVICE_REGISTRY_GITHUB_TOKEN
    string "GitHub API token for device registry"
    help
      Personal Access Token with repo write permissions.
      Create at: https://github.com/settings/tokens
      Required scopes: repo (full control of private repositories)

config RPR_DEVICE_REGISTRY_REPO_OWNER
    string "GitHub repository owner"
    default "enera-international"
    help
      GitHub username or organization that owns the registry repository.

config RPR_DEVICE_REGISTRY_REPO_NAME
    string "GitHub repository name"
    default "device-registry"
    help
      Name of the GitHub repository used for device registry.

config RPR_DEVICE_REGISTRY_PREFERRED_ID_LENGTH
    int "Preferred device ID length"
    range 4 24
    default 6
    help
      Preferred length for device ID. Will be extended automatically
      if collisions are detected.

config RPR_FIRMWARE_VERSION
    string "Firmware version string"
    default "1.0.0"
    help
      Firmware version to include in device registration.

endif # RPR_MODULE_DEVICE_REGISTRY
```

## src/dfu_manager/Kconfig.dfu
```kconfig
menuconfig RPR_MODULE_DFU
    bool "Enable DFU module"
    select FLASH
    select STREAM_FLASH
    select FLASH_MAP
    select REBOOT
    select IMG_MANAGER
    select MPU_ALLOW_FLASH_WRITE
  	default y if BOOTLOADER_MCUBOOT
    help
      Enables firmware update module.

if RPR_MODULE_DFU
config RPR_MODULE_DFU_LOG_LEVEL
    int "DFU module log level"
    range 0 4
    default 3
    help
      0=OFF, 1=ERROR, 2=WARNING, 3=INFO, 4=DEBUG

config RPR_IMAGE_INTEGRITY_CHECK
    bool "Enable image integrity check"
    select IMG_ENABLE_IMAGE_CHECK
    default y if RPR_HASH_CALCULATION
    help
      Enable verification of firmware update image integrity via hash comparison.

config RPR_DFU_SHELL_TEST
    bool "Enable MCUboot shell commands for DFU testing"
    select MCUBOOT_SHELL
    default y if RPR_MODULE_CLI_SHELL_TEST
    help
      Enable MCUboot shell support for testing and debugging DFU functionality.
endif
```

## src/ethernet/Kconfig.ethernet
```kconfig
menuconfig RPR_ETHERNET
    bool "Enable Ethernet support"
    depends on RPR_NETWORKING && NET_NATIVE
    select NET_L2_ETHERNET
    select MDIO
    select NET_ARP
    select NET_DHCPV4
    select INIT_STACKS
    default y if RPR_NETWORKING
    help
      Enable Ethernet networking stack and basic DHCP support.

if RPR_ETHERNET

config RPR_ETHERNET_LOG_LEVEL
    int "Ethernet module log level"
    range 0 4
    default 3
    help
      0=OFF, 1=ERROR, 2=WARNING, 3=INFO, 4=DEBUG

endif # RPR_ETHERNET
```

## src/examples/Kconfig.examples
```kconfig
config EXAMPLES_ENABLE_MAIN_EXAMPLES
    bool "Enable Main Examples"
    depends on RPR_NETWORKING
    help
      Enable core example modules:
      - power_supervisor
      - domain_logic
      - alnicko_server
      Requires:
        CONFIG_RPR_NETWORKING

config EXAMPLES_ENABLE_ALNICKO_SHELL
    bool "Enable Alnicko Shell Example"
    depends on RPR_MODULE_HTTP && RPR_NETWORKING && RPR_MODULE_DFU
    help
      Enable shell-based interaction with Alnicko server.
      Requires:
        CONFIG_RPR_MODULE_HTTP
        CONFIG_RPR_NETWORKING

if EXAMPLES_ENABLE_MAIN_EXAMPLES || EXAMPLES_ENABLE_ALNICKO_SHELL

config EXAMPLES_ALNICKO_SERVER_LOG_LEVEL
    int "Alnicko server example log level"
    range 0 4
    default 3
    help
      Set logging level for example modules:
      0=OFF, 1=ERROR, 2=WARNING, 3=INFO, 4=DEBUG

endif # EXAMPLES_ENABLE_MAIN_EXAMPLES || EXAMPLES_ENABLE_ALNICKO_SHELL

if EXAMPLES_ENABLE_MAIN_EXAMPLES 

config EXAMPLES_DOMAIN_LOGIC_LOG_LEVEL
    int "Domain logic example log level"
    range 0 4
    default 3
    help
      Set logging level for example modules:
      0=OFF, 1=ERROR, 2=WARNING, 3=INFO, 4=DEBUG

config EXAMPLES_POWER_SUPERVISOR_LOG_LEVEL
    int "Power supervisor example log level"
    range 0 4
    default 3
    help
      Set logging level for example modules:
      0=OFF, 1=ERROR, 2=WARNING, 3=INFO, 4=DEBUG

config EXAMPLES_POWER_SUPERVISOR_BATTERY_LOW_THRESHOLD
    int "Battery low threshold (%)"
    default 20
    help
      Device will power off when battery is below this level.

config EXAMPLES_POWER_SUPERVISOR_BATTERY_HIGH_THRESHOLD
    int "Battery high threshold (%)"
    default 95
    help
      Device starts charging if battery is below this level.

config EXAMPLES_POWER_SUPERVISOR_CHECK_INTERVAL_MS
    int "Power check interval (ms)"
    default 60000
    help
      Interval for checking battery and power status.


config EXAMPLES_DOMAIN_LOGIC_NET_CONNECT_TIMEOUT_MS
    int "Network connect timeout (ms)"
    default 30000
    help
      Maximum time to wait for network connection on startup.

config EXAMPLES_DOMAIN_LOGIC_TARGET_AUDIO_FILE
    string "Target audio file to download"
    default "20-16.opus"
    help
      Audio file name to be downloaded during execution.

config EXAMPLES_DOMAIN_LOGIC_AUTO_CONNECT_ON_START
    bool "Auto-connect to network on start"
    default y
    depends on RPR_MODULE_HTTP
    help
      If enabled, the example will try to connect to network on boot.
      Requires:
        CONFIG_RPR_MODULE_HTTP

config EXAMPLES_DOMAIN_LOGIC_AUTO_DOWNLOAD_AUDIO
    bool "Auto-download audio file on start"
    default y
    help
      If enabled, the target audio file will be downloaded automatically.

config EXAMPLES_DOMAIN_LOGIC_MAX_PING_LOSSES
    int "Maximum allowed ping losses before action"
    default 240
    help
      Defines how many ping failures are tolerated.

config EXAMPLES_DOMAIN_LOGIC_AUDIO_MAX_PING_LOSSES
    int "Maximum allowed ping losses for audio thread before action"
    default 5
    help
      Defines how many ping for audio thread failures are tolerated.

config EXAMPLES_DOMAIN_LOGIC_MIC_INACTIVE_THRESHOLD
    int "Microphone inactivity threshold during playback"
    default 6
    help
      Number of loop cycles without detected microphone input before triggering a warning.

endif # EXAMPLES_ENABLE_MAIN_EXAMPLES 
```

## src/file_manager/Kconfig.file
```kconfig
menuconfig RPR_MODULE_FILE_MANAGER
    bool "Enable File Manager Module"
	select FLASH
	select FLASH_MAP
	select FILE_SYSTEM
	select FILE_SYSTEM_LITTLEFS
    default y if RPR_MODULE_HTTP || RPR_MODULE_AUDIO_PLAYER
    help
      Enable file management functions (e.g., HTTP file download).
      Automatically selects CONFIG_FLASH, CONFIG_FLASH_MAP, CONFIG_FILE_SYSTEM, 
      CONFIG_FILE_SYSTEM_LITTLEFS.

if RPR_MODULE_FILE_MANAGER

config RPR_FILE_MANAGER_LOG_LEVEL
    int "File Manager log level"
    range 0 4
    default 3
    help
      Set logging level for the File Manager module:
      0=OFF, 1=ERROR, 2=WARNING, 3=INFO, 4=DEBUG

config RPR_FS_MNT_POINT
    string "Filesystem mount point"
    default "/lfs"
    help
      Filesystem path used as a mount point for file operations.

config RPR_AUDIO_DEFAULT_PATH
    string "Default path for downloaded audio files"
    default "/lfs/audio"
    help
      Path where audio files are stored by default. Used by audio playback and download logic.

config RPR_WIFI_CONFIG_DEFAULT_PATH
    string "Default path for saved Wi-Fi configuration"
    default "/lfs/wifi"
    help
      Path where Wi-Fi configuration files (e.g., SSID and password) are stored by default.
      This path is used by the Wi-Fi management module to load or save network settings

config RPR_FILENAME_MAX_LEN
    int "Maximum length of an audio file name"
    default 67
    help
      Specifies the maximum number of characters allowed in the file name.

  config RPR_FOLDER_PATH_MAX_LEN
    int "Maximum length of folder path for downloads"
    default 200
    help
      Maximum length for the folder path (e.g., /lfs/audio).

  config RPR_FILE_SYSTEM_LFS_SHELL
    bool "Enable LFS shell commands for testing"
    select FILE_SYSTEM_SHELL
    default y if RPR_MODULE_CLI_SHELL_TEST
    help
      Enable shell commands to test the file system (e.g., ls, read, write).
      Useful for verifying LFS mount and file operations manually via CLI.

endif
```

## src/http_log_client/Kconfig
```kconfig
# HTTP Log Client Configuration

menuconfig HTTP_LOG_CLIENT
	bool "HTTP Log Client support"
	depends on NETWORKING && HTTP_CLIENT
	help
	  Enable HTTP log client for sending device logs to a centralized
	  log server. Logs are buffered locally and sent in batches to
	  reduce network overhead.

if HTTP_LOG_CLIENT

config HTTP_LOG_CLIENT_LOG_LEVEL
	int "HTTP Log Client log level"
	default 3
	help
	  Log level for HTTP log client module (0=OFF, 1=ERR, 2=WRN, 3=INF, 4=DBG)

config HTTP_LOG_CLIENT_MAX_BATCH_SIZE
	int "Maximum logs per batch"
	default 50
	range 10 200
	help
	  Maximum number of log entries to send in a single HTTP request.
	  Larger batches are more efficient but require more memory.

config HTTP_LOG_CLIENT_DEFAULT_BUFFER_SIZE
	int "Default log buffer size"
	default 500
	range 100 2000
	help
	  Default number of log entries that can be buffered before
	  oldest entries are dropped. Can be overridden at runtime.

config HTTP_LOG_CLIENT_STACK_SIZE
	int "HTTP log client thread stack size"
	default 4096
	help
	  Stack size for the HTTP log client worker thread.

config HTTP_LOG_CLIENT_THREAD_PRIORITY
	int "HTTP log client thread priority"
	default 10
	help
	  Priority of the HTTP log client worker thread.
	  Lower values mean higher priority.

config HTTP_LOG_CLIENT_DEFAULT_SERVER_URL
	string "Default log server URL"
	default "http://37.123.169.250"
	help
	  Default URL of the log server. Can be overridden at runtime.

config HTTP_LOG_CLIENT_COMPRESSION
	bool "Enable log compression"
	default n
	help
	  Enable gzip compression for log payloads. Reduces bandwidth
	  but increases CPU usage.

endif # HTTP_LOG_CLIENT
```
